## arch/arm/mach-mt6592/Kconfig
```kconfig
if ARCH_MT6592

menu "MT6592 Board Support Package"

choice
	bool "Board"

config MT6592_FPGA
	bool "MT6592 FPGA"
	select ARM_L1_CACHE_SHIFT_6
	help
	  Select if you are using the FPGA board.

config MT6592_EVB_BOARD
	bool "MT6592 EVB BOARD"
	select ARM_L1_CACHE_SHIFT_6
	help
	 Select if you are using an EVB board.

endchoice

#config MTK_FPGA
#	bool "MT6592 FPGA"
#	select ARM_L1_CACHE_SHIFT_6
#	help
#	  Select if you are using the FPGA board.

config MT6592M
	bool "MT6592M segment selection"
	depends on ARCH_MT6592
	help
	 Select if you need to config as MT6592M CPU segment.

config MAX_DRAM_SIZE_SUPPORT
	hex "The maximum size of the DRAM can be supported in the kernel"
	default 0x10000000
	depends on ARCH_MT6592
	help
		Define the maximum size of the kernel can be supported.
	        If will modify the memory size if it size is smaller than 
                the memory size passed by the boot loader to the MAX_DRAM_SIZE_SUPPORT.
   		Notice that the maximum DRAM size is including the memory size
	        reserved for the modem and the PMEM.
config MT6592_RAMOOPS_ADDR
	hex "Physical address of the ramoops (pstore) region"
	default 0xB0000000
	depends on ARCH_MT6592 && PSTORE_RAM
	help
	  Start of the DRAM block that is memblock-reserved and handed to
	  ramoops, so the previous boot's console log survives a warm reset.
	  It must lie in DRAM the bootloader hands to the kernel, away from
	  the preloader/LK scratch area (below 0x84000000), the framebuffer
	  and connsys carve-outs at the top of DRAM, and the DFS dummy-read
	  page at the DRAM midpoint. If the range is not plain free DRAM at
	  boot the reservation is skipped and ramoops is not registered.

config MT6592_RAMOOPS_SIZE
	hex "Size of the ramoops (pstore) region"
	default 0x200000
	depends on ARCH_MT6592 && PSTORE_RAM
	help
	  Must be a power of two. 2 MiB gives two 256 KiB console buffers,
	  a 256 KiB pmsg buffer and ten 128 KiB oops/panic records.

endmenu


endif
```

## drivers/misc/mediatek/aee/Kconfig
```kconfig
config HAVE_AEE_FEATURE
	bool "HAVE_AEE_FEATURE"
	help
	  AEE (Android Exception Engine) that designed by  Mediatek is an
	  exception catching and debugging information generation mechanism.
	  It can collect and dump information to filesystem
	  (/sdcard/mtklog/aee_exp)  when fatel occur(E.g. kernel
	  panic/android system server crash and ..)

config MTK_AEE_FEATURE
	tristate "Enable Android Exception Enhancement"
	default n
	select FIQ_GLUE if !TRUSTONIC_TEE_SUPPORT && !ARM_PSCI
	---help---
	  Enable Android Exception Enhancement

config MTK_AEE_AED
	tristate "Enable AEE Kernel Exception Report Daemon"
	default y

config MTK_AEE_IPANIC
	tristate "Enable AEE Kernel Panic Dump"
	default y

config MTK_AEE_POWERKEY_HANG_DETECT
	bool "powerkey monitor"
	default n

config MTK_KLOG_SINK
	bool "Periodic kernel log sink into expdb"
	default n
	depends on MTK_AEE_IPANIC
	---help---
	  Periodically write the kernel ring buffer into the expdb partition
	  using the AEE dump writer, so the log survives a hang as well as a
	  panic.

	  On a board with no UART, no device tree (so no pstore region can be
	  passed or reserved) and a failure mode that hangs rather than
	  panics, this is the only way to read back what the kernel was
	  doing. Snapshots are written past the end of the ipanic record
	  table so they never overwrite a real panic dump.

	  Writes the last 64 KiB every 2 seconds and the full ring buffer
	  every 30 seconds, so it is only worth enabling while bringing up
	  a kernel.
```

## drivers/misc/mediatek/ram_console/Kconfig
```kconfig
config MTK_RAM_CONSOLE
	bool "mt ram console" 

config MTK_RAM_CONSOLE_USING_SRAM
	bool "Using SRAM as ram console storage"
	depends on MTK_RAM_CONSOLE

config MTK_RAM_CONSOLE_USING_DRAM
	bool "Using DRAM as ram console storage"
	depends on MTK_RAM_CONSOLE

config MTK_RAM_CONSOLE_PSTORE
	bool "Route the MTK ram console through pstore"
	depends on MTK_RAM_CONSOLE && PSTORE
	default n
	help
	  The MTK ram console used to switch itself to a pstore backed
	  implementation whenever CONFIG_PSTORE was set. Keep that behind
	  its own option so that enabling pstore/ramoops for
	  /sys/fs/pstore does not stop the SRAM ram console from capturing
	  the kernel log for /proc/last_kmsg.

config MTK_RAM_CONSOLE_SIZE
	hex "MTK RAM console  address"
	default 0
	depends on MTK_RAM_CONSOLE

config MTK_RAM_CONSOLE_ADDR
	hex "MTK RAM console buffer size"
	default 0
	depends on MTK_RAM_CONSOLE   

config MTK_RAM_CONSOLE_DRAM_SIZE
	hex "MTK RAM console dram address"
	default 0
	depends on MTK_RAM_CONSOLE

config MTK_RAM_CONSOLE_DRAM_ADDR
	hex "MTK RAM console dram size"
	default 0
	depends on MTK_RAM_CONSOLE   
```
